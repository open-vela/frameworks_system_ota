## Kconfig
```kconfig
#
# For a description of the syntax of this configuration file,
# see the file kconfig-language.txt in the NuttX tools repository.
#

config OTA_UI
	bool "Enable OTA UI module"
	default n
	depends on GRAPHICS_LVGL
	---help---
		This option will display upgrade progress on panel.

if OTA_UI

config OTA_UI_PROG_SYNC_TIME
	int "OTA UI progress sync time"
	default 40000

config OTA_UI_FINISH_EXEC_CMD
	string "OTA UI end exec command"
	default "reboot 0"

config OTA_UI_STACKSIZE
	int "OTA UI stack size"
	default 4096
	---help---
		The stack size to use the otaUI task.  Default: 4096

config OTA_UI_PRIORITY
	int "OTA UI task priority"
	default 100
	---help---
		The priority to use the otaUI task.  Default: 100

endif

config UTILS_AVB_VERIFY
	tristate "AVB verification tools"
	default n
	depends on KVDB
	depends on LIB_AVB
	---help---
		Enable AVB verification tools

if UTILS_AVB_VERIFY

config UTILS_AVB_VERIFY_PROGNAME
	string "Program name of AVB verification tools"
	default "avb_verify"
	---help---
		This is the name of the program that will be used when the NSH ELF
		program is installed.

config UTILS_AVB_VERIFY_PRIORITY
	int "Priority of AVB verification tools"
	default 100

config UTILS_AVB_VERIFY_STACKSIZE
	int "Stack size of AVB verification tools"
	default 4096

endif

config UTILS_ZIP_VERIFY
	tristate "OTA image verify"
	default n
	depends on LIB_AVB && LIB_AVB_SHA256
	depends on LIB_ZLIB
	---help---
		This option will enable a upgrade package verify.

if UTILS_ZIP_VERIFY

config UTILS_ZIP_VERIFY_PROGNAME
	string "Program name"
	default "zip_verify"
	---help---
		This is the name of the program that will be used when the NSH ELF
		program is installed.

config UTILS_ZIP_VERIFY_STACKSIZE
	int "Upgrade package verify stack size"
	default 4096
	---help---
		The stack size to use the upgrade package verify task.  Default: 4096

config UTILS_ZIP_VERIFY_PRIORITY
	int "upgrade package verify priority"
	default 100
	---help---
		The priority to use the upgrade package verify task.  Default: 100

endif
```
